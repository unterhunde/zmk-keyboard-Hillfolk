## boards/shields/Hillfolk/Kconfig.shield
```kconfig
config SHIELD_HILLFOLK_LEFT
    def_bool $(shields_list_contains,Hillfolk_left)

config SHIELD_HILLFOLK_RIGHT
    def_bool $(shields_list_contains,Hillfolk_right)
```

## config/boards/shields/Hillfolk/Kconfig.defconfig
```kconfig
if SHIELD_HILLFOLK_LEFT

config ZMK_KEYBOARD_NAME
    default "Hillfolk"

config ZMK_SPLIT_ROLE_CENTRAL
    default y

endif

if SHIELD_HILLFOLK_LEFT || SHIELD_HILLFOLK_RIGHT

config ZMK_SPLIT
    default y

endif
```
