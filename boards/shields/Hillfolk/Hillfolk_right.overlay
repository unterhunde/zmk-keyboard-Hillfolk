// Right Overlay
#include "Hillfolk.dtsi"

&default_transform {
    col-offset = <6>;
};

&default_kscan {
    col-gpios = <&pro_micro 10 GPIO_ACTIVE_HIGH>, // Col 0 black wire
                <&pro_micro 16 GPIO_ACTIVE_HIGH>, // Col 1 white wire
                <&pro_micro 14 GPIO_ACTIVE_HIGH>, // Col 2 green wire
                <&pro_micro 15 GPIO_ACTIVE_HIGH>, // Col 3 blue wire
                <&pro_micro 18 GPIO_ACTIVE_HIGH>, // Col 4 yellow wire
                <&pro_micro 19 GPIO_ACTIVE_HIGH>; // Col 5 red wire
};
